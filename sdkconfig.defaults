## sdkconfig.defaults
```kconfig
# esp32s2 has 4MB, esp32s3 has 8MB
CONFIG_ESPTOOLPY_FLASHSIZE_4MB=y

# Enable OTA partitions
CONFIG_PARTITION_TABLE_TWO_OTA=y

# Enable Tiny USB
CONFIG_TINYUSB_HID_COUNT=1

# Fix 'Header fields are too long' error with Firefox
CONFIG_HTTPD_MAX_REQ_HDR_LEN=1024
CONFIG_HTTPD_MAX_URI_LEN=1024
```
